## Config.in
```kconfig
source "$BR2_EXTERNAL_HERO_PATH/package/Config.in"

source "$BR2_EXTERNAL_HERO_PATH/package/ariane-support/Config.in"
source "$BR2_EXTERNAL_HERO_PATH/package/hero-apps/Config.in"
source "$BR2_EXTERNAL_HERO_PATH/package/hero-openmp/Config.in"
source "$BR2_EXTERNAL_HERO_PATH/package/libhero-target/Config.in"
source "$BR2_EXTERNAL_HERO_PATH/package/libpulp/Config.in"
source "$BR2_EXTERNAL_HERO_PATH/package/prem-cmux/Config.in"
source "$BR2_EXTERNAL_HERO_PATH/package/pulp-driver/Config.in"
source "$BR2_EXTERNAL_HERO_PATH/package/riscv-pk-ariane/Config.in"
source "$BR2_EXTERNAL_HERO_PATH/package/vitetris/Config.in"
source "$BR2_EXTERNAL_HERO_PATH/package/zynq-mkbootimage/Config.in.host"

config BR2_HERO_AUTHORIZED_KEYS
	string "Optional authorized keys file to install"
	help
	  Authorized keys file to install for automatic SSH access.
	  Leave empty to not install any authorized keys.

config BR2_HERO_BITSTREAM
	string "Optional bitstream to load for targeted FPGA"
	help
	  Location of a bitstream to load for the FPGA device during
	  boot.  Leave empty to not load any bitstream.

config BR2_HERO_EXT_MOUNT
	string "External mount point to load for chrooting"
	help
	  Location to mount as external root, for example NFS partition.
	  Binds system to the filesystem.  Options can be specified
	  before (with -o) as the options are completely forwarded to
	  mount.  Leave empty to not mount external partition.

config BR2_HERO_ETH_IP_ADDR
	string "Optional static IP address for the Host"
	help
	  Static IP address. Leave empty to use DHCP.

config BR2_HERO_ETH_NETMASK
	string "Optional static IP netmask"
	help
	  Static netmask. Only considered when static IP address is set.

config BR2_HERO_ETH_GATEWAY
	string "Optional static IP gateway"
	help
	  Static gateway. Only considered when static IP address is set.

config BR2_HERO_ETH_DNS
	string "Optional static IP DNS"
	help
	  Static DNS server. Only considered when static IP address is set.
```

## board/occamy/fit_kernel_dtb.its
```
/dts-v1/;

/{
  description = "U-Boot fitImage for Occamy from heroccamy";
  #address-cells = <1>;

  images {
    // Older u-boot images don't accept '@' in node names and fail verification
    kernel0 {
      description = "Linux kernel from heroccamy";
      data = /incbin/("Image.gz");
      type = "kernel";
      arch = "riscv";
      os = "linux";
      compression = "gzip";
      load = <0x85000000>;
      entry = <0x85000000>;
      hash0 {
        algo = "sha1";
      };
    };
    fdt0 {
      description = "Flattened Device Tree blob from heroccamy";
      data = /incbin/("occamy.dtb");
      type = "flat_dt";
      arch = "arm";
      compression = "none";
      hash0 {
        algo = "sha1";
      };
    };
  };
  configurations {
    default = "conf0";
    conf0 {
      description = "Linux kernel, FDT blob from heroccamy";
      kernel = "kernel0";
      fdt = "fdt0";
      hash0 {
        algo = "sha1";
      };
    };
  };
};
```

## configs/aarch64_hero_defconfig
```kconfig
# Host
BR2_CCACHE=y
BR2_CCACHE_USE_BASEDIR=n

# Architecture
BR2_aarch64=y

# Toolchain
BR2_TOOLCHAIN_EXTERNAL=y
BR2_TOOLCHAIN_EXTERNAL_CUSTOM=y
BR2_TOOLCHAIN_EXTERNAL_PREINSTALLED=y
BR2_TOOLCHAIN_EXTERNAL_PATH="$(RISCV)"
BR2_TOOLCHAIN_EXTERNAL_CUSTOM_PREFIX="aarch64-unknown-linux-gnu"
BR2_TOOLCHAIN_EXTERNAL_GCC_8=y
BR2_TOOLCHAIN_EXTERNAL_HEADERS_4_14=y
BR2_TOOLCHAIN_EXTERNAL_CUSTOM_GLIBC=y
BR2_TOOLCHAIN_EXTERNAL_CXX=y

# System
BR2_TARGET_GENERIC_HOSTNAME="hero"
BR2_TARGET_GENERIC_ISSUE="Welcome to HERO"
BR2_TARGET_GENERIC_PASSWD_SHA512=y
BR2_TARGET_GENERIC_PASSWD_METHOD="sha-512"
BR2_SYSTEM_DHCP="eth0"
BR2_ROOTFS_SKELETON_DEFAULT=y
BR2_ROOTFS_OVERLAY="$(BR2_EXTERNAL_HERO_PATH)/board/common/overlay/"
BR2_ROOTFS_DEVICE_CREATION_DYNAMIC_MDEV=y
BR2_TARGET_GENERIC_GETTY=y
BR2_TARGET_GENERIC_GETTY_PORT="ttyPS0"
BR2_TARGET_GENERIC_GETTY_BAUDRATE="115200"
BR2_TARGET_GENERIC_GETTY_TERM="vt100"
BR2_TARGET_GENERIC_REMOUNT_ROOTFS_RW=y
BR2_TARGET_ROOTFS_EXT2=y
BR2_TARGET_ROOTFS_EXT2_4=y

# Kernel
# NOTE: should be the same kernel as in zynqmp config to use the kernel modules in external mount
BR2_LINUX_KERNEL=y
BR2_LINUX_KERNEL_CUSTOM_GIT=y
BR2_LINUX_KERNEL_CUSTOM_REPO_URL="git://github.com/Xilinx/linux-xlnx.git"
BR2_LINUX_KERNEL_CUSTOM_REPO_VERSION="xilinx-v2018.2"
BR2_LINUX_KERNEL_DEFCONFIG="xilinx_zynqmp"

# Skeleton and BusyBox
BR2_PACKAGE_BUSYBOX=y
BR2_PACKAGE_BUSYBOX_CONFIG="$(BR2_EXTERNAL_HERO_PATH)/board/hero/busybox.config"

# Host packages
BR2_PACKAGE_HOST_CMAKE=y
BR2_PACKAGE_HOST_PKGCONF=y

# Local packages
BR2_PACKAGE_HERO_PLATFORM="TE0808"
BR2_PACKAGE_OVERRIDE_FILE="$(BR2_EXTERNAL_HERO_PATH)/local.mk"
BR2_PACKAGE_LIBPULP=y
BR2_PACKAGE_PULP_DRIVER=y
BR2_PACKAGE_LIBHERO_TARGET=y
BR2_PACKAGE_HERO_APPS=y
BR2_PACKAGE_HERO_OPENMP=y

# Generic packages
BR2_PACKAGE_NFS_UTILS=y
BR2_PACKAGE_LIBNFS=y
BR2_PACKAGE_IPROUTE2=y
BR2_PACKAGE_DROPBEAR=y
BR2_PACKAGE_IFUPDOWN_SCRIPTS=y
BR2_PACKAGE_BZIP2=y
BR2_PACKAGE_XZ=y
BR2_PACKAGE_DHRYSTONE=y
BR2_PACKAGE_STRACE=y
BR2_PACKAGE_NETPERF=y
BR2_PACKAGE_WHETSTONE=y
BR2_PACKAGE_BINUTILS=y
BR2_PACKAGE_E2FSPROGS=y
BR2_PACKAGE_E2FSPROGS_FSCK=y
BR2_PACKAGE_ZLIB=y
BR2_PACKAGE_LIBZLIB=y
BR2_PACKAGE_OPENSSL=y
BR2_PACKAGE_LIBOPENSSL=y
BR2_PACKAGE_LIBFUSE=y
BR2_PACKAGE_EXPAT=y
BR2_PACKAGE_NSS_MDNS=y
BR2_PACKAGE_LIBDAEMON=y
BR2_PACKAGE_NCURSES=y
BR2_PACKAGE_NCURSES_ADDITIONAL_TERMINFO=""
BR2_PACKAGE_PCRE=y
BR2_PACKAGE_PCRE_UTF=y
BR2_PACKAGE_PCRE_UCP=y
BR2_PACKAGE_POPT=y
BR2_PACKAGE_AVAHI=y
BR2_PACKAGE_AVAHI_AUTOIPD=y
BR2_PACKAGE_AVAHI_DAEMON=y
BR2_PACKAGE_ETHTOOL=y
BR2_PACKAGE_ETHTOOL_PRETTY_PRINT=y
BR2_PACKAGE_RSYNC=y
BR2_PACKAGE_SCREEN=y
BR2_PACKAGE_UTIL_LINUX=y
BR2_PACKAGE_UTIL_LINUX_LIBBLKID=y
BR2_PACKAGE_UTIL_LINUX_LIBMOUNT=y
BR2_PACKAGE_UTIL_LINUX_LIBUUID=y
BR2_PACKAGE_NANO=y
BR2_PACKAGE_NANO_TINY=y
BR2_PACKAGE_UEMACS=y
```

## configs/ariane_defconfig
```kconfig
# Architecture
BR2_riscv=y
BR2_riscv_custom=y
BR2_RISCV_ISA_CUSTOM_RVM=y
BR2_RISCV_ISA_CUSTOM_RVC=y

# Toolchain
BR2_TOOLCHAIN_EXTERNAL=y
BR2_TOOLCHAIN_EXTERNAL_PATH="$(RISCV)"
BR2_TOOLCHAIN_EXTERNAL_CUSTOM_PREFIX="riscv64-unknown-linux-gnu"
BR2_TOOLCHAIN_EXTERNAL_GCC_8=y
BR2_TOOLCHAIN_EXTERNAL_HEADERS_4_20=y
BR2_TOOLCHAIN_EXTERNAL_CUSTOM_GLIBC=y
BR2_TOOLCHAIN_EXTERNAL_CXX=y

# System
BR2_TARGET_GENERIC_HOSTNAME="ariane"
BR2_SYSTEM_DHCP="eth0"

# Bootloader
# FIXME: this should be a boot loader target
BR2_PACKAGE_RISCV_PK_ARIANE=y
BR2_PACKAGE_RISCV_PK_ARIANE_EXTRA_CONFIG_OPTS="--enable-logo --with-logo=$(BR2_EXTERNAL_HERO_PATH)/board/common/boot_logo.txt"

# Filesystem
BR2_TARGET_ROOTFS_INITRAMFS=y
BR2_ROOTFS_OVERLAY="$(BR2_EXTERNAL_HERO_PATH)/board/common/overlay/"
BR2_ROOTFS_POST_BUILD_SCRIPT="$(BR2_EXTERNAL_HERO_PATH)/board/common/post_build.sh"
BR2_ROOTFS_POST_IMAGE_SCRIPT="$(BR2_EXTERNAL_HERO_PATH)/board/ariane/post_image.sh"

# Kernel
BR2_LINUX_KERNEL=y
BR2_LINUX_KERNEL_CUSTOM_VERSION=y
BR2_LINUX_KERNEL_CUSTOM_VERSION_VALUE="4.20.8"
BR2_LINUX_KERNEL_PATCH="$(BR2_EXTERNAL_HERO_PATH)/board/ariane/linux-patches/"
BR2_LINUX_KERNEL_USE_CUSTOM_CONFIG=y
BR2_LINUX_KERNEL_CUSTOM_CONFIG_FILE="$(BR2_EXTERNAL_HERO_PATH)/board/common/linux.config"
BR2_LINUX_KERNEL_CONFIG_FRAGMENT_FILES="$(BR2_EXTERNAL_HERO_PATH)/board/ariane/linux-extras.config"
BR2_LINUX_KERNEL_VMLINUX=y

# BusyBox
BR2_PACKAGE_BUSYBOX_CONFIG="$(BR2_EXTERNAL_HERO_PATH)/board/common/busybox.config"

# Local packages
BR2_PACKAGE_ARIANE_SUPPORT=y
BR2_PACKAGE_VITETRIS=y

# Generic packages
BR2_PACKAGE_NFS_UTILS=y
BR2_PACKAGE_LIBNFS=y
BR2_PACKAGE_IPROUTE2=y
BR2_PACKAGE_DROPBEAR=y
BR2_PACKAGE_IFUPDOWN_SCRIPTS=y
```

## configs/hero_defconfig
```kconfig
# Host
BR2_CCACHE=y
BR2_CCACHE_USE_BASEDIR=n

# Architecture
BR2_riscv=y
BR2_riscv_custom=y
BR2_RISCV_ISA_CUSTOM_RVM=y
BR2_RISCV_ISA_CUSTOM_RVC=y

# Toolchain
BR2_TOOLCHAIN_EXTERNAL=y
BR2_TOOLCHAIN_EXTERNAL_CUSTOM=y
BR2_TOOLCHAIN_EXTERNAL_PREINSTALLED=y
BR2_TOOLCHAIN_EXTERNAL_PATH="$(RISCV)"
BR2_TOOLCHAIN_EXTERNAL_CUSTOM_PREFIX="riscv64-hero-linux-gnu"
BR2_TOOLCHAIN_EXTERNAL_GCC_8=y
BR2_TOOLCHAIN_EXTERNAL_HEADERS_4_20=y
BR2_TOOLCHAIN_EXTERNAL_CUSTOM_GLIBC=y
BR2_TOOLCHAIN_EXTERNAL_CXX=y

# System
BR2_TARGET_GENERIC_HOSTNAME="hero"
BR2_TARGET_GENERIC_ISSUE="Welcome to HERO"
BR2_TARGET_GENERIC_PASSWD_SHA512=y
BR2_TARGET_GENERIC_PASSWD_METHOD="sha-512"
BR2_SYSTEM_DHCP="eth0"
BR2_ROOTFS_SKELETON_DEFAULT=y
BR2_ROOTFS_OVERLAY="$(BR2_EXTERNAL_HERO_PATH)/board/common/overlay/"
BR2_ROOTFS_POST_BUILD_SCRIPT="$(BR2_EXTERNAL_HERO_PATH)/board/common/post_build.sh $(BR2_EXTERNAL_HERO_PATH)/board/hero/post_build.sh"
BR2_ROOTFS_POST_IMAGE_SCRIPT="$(BR2_EXTERNAL_HERO_PATH)/board/ariane/post_image.sh"
BR2_ROOTFS_DEVICE_CREATION_DYNAMIC_MDEV=y
BR2_TARGET_GENERIC_GETTY=y
BR2_TARGET_GENERIC_GETTY_PORT="ttyPS0"
BR2_TARGET_GENERIC_GETTY_BAUDRATE="115200"
BR2_TARGET_GENERIC_GETTY_TERM="vt100"
BR2_TARGET_GENERIC_REMOUNT_ROOTFS_RW=y
BR2_TARGET_ROOTFS_EXT2=y
BR2_TARGET_ROOTFS_EXT2_4=y

# Bootloader
BR2_PACKAGE_RISCV_PK_ARIANE=y
BR2_PACKAGE_RISCV_PK_ARIANE_LOGO="$(BR2_EXTERNAL_HERO_PATH)/board/common/boot_logo.txt"

# Kernel
# NOTE: should be the same kernel as in Ariane config to use the kernel modules in external mount
BR2_LINUX_KERNEL=y
BR2_LINUX_KERNEL_CUSTOM_VERSION=y
BR2_LINUX_KERNEL_CUSTOM_VERSION_VALUE="4.20.8"
BR2_LINUX_KERNEL_PATCH="$(BR2_EXTERNAL_HERO_PATH)/board/ariane/linux-patches/"
BR2_LINUX_KERNEL_USE_CUSTOM_CONFIG=y
BR2_LINUX_KERNEL_CUSTOM_CONFIG_FILE="$(BR2_EXTERNAL_HERO_PATH)/board/common/linux.config"
BR2_LINUX_KERNEL_CONFIG_FRAGMENT_FILES="$(BR2_EXTERNAL_HERO_PATH)/board/ariane/linux-extras.config"
BR2_LINUX_KERNEL_VMLINUX=y

# Skeleton and BusyBox
BR2_PACKAGE_BUSYBOX=y
BR2_PACKAGE_BUSYBOX_CONFIG="$(BR2_EXTERNAL_HERO_PATH)/board/hero/busybox.config"

# Host packages
BR2_PACKAGE_HOST_CMAKE=y
BR2_PACKAGE_HOST_PKGCONF=y

# Local packages
BR2_HERO_PLATFORM="ARIANE"
BR2_PACKAGE_OVERRIDE_FILE="$(BR2_EXTERNAL_HERO_PATH)/local.mk"
BR2_PACKAGE_ARIANE_SUPPORT=y
BR2_PACKAGE_ARIANE_SUPPORT_RANDOM_INIT=y
BR2_PACKAGE_LIBPULP=y
BR2_PACKAGE_PULP_DRIVER=y
BR2_PACKAGE_LIBHERO_TARGET=y
BR2_PACKAGE_HERO_APPS=y
BR2_PACKAGE_HERO_OPENMP=y

# Generic packages
BR2_PACKAGE_NFS_UTILS=y
BR2_PACKAGE_LIBNFS=y
BR2_PACKAGE_IPROUTE2=y
BR2_PACKAGE_DROPBEAR=y
BR2_PACKAGE_IFUPDOWN_SCRIPTS=y
BR2_PACKAGE_BZIP2=y
BR2_PACKAGE_XZ=y
BR2_PACKAGE_DHRYSTONE=y
BR2_PACKAGE_STRACE=y
BR2_PACKAGE_NETPERF=y
BR2_PACKAGE_WHETSTONE=y
BR2_PACKAGE_BINUTILS=y
BR2_PACKAGE_E2FSPROGS=y
BR2_PACKAGE_E2FSPROGS_FSCK=y
BR2_PACKAGE_ZLIB=y
BR2_PACKAGE_LIBZLIB=y
BR2_PACKAGE_OPENSSL=y
BR2_PACKAGE_LIBOPENSSL=y
BR2_PACKAGE_LIBFUSE=y
BR2_PACKAGE_EXPAT=y
BR2_PACKAGE_NSS_MDNS=y
BR2_PACKAGE_LIBDAEMON=y
BR2_PACKAGE_NCURSES=y
BR2_PACKAGE_NCURSES_ADDITIONAL_TERMINFO=""
BR2_PACKAGE_PCRE=y
BR2_PACKAGE_PCRE_UTF=y
BR2_PACKAGE_PCRE_UCP=y
BR2_PACKAGE_POPT=y
BR2_PACKAGE_AVAHI=y
BR2_PACKAGE_AVAHI_AUTOIPD=y
BR2_PACKAGE_AVAHI_DAEMON=y
BR2_PACKAGE_ETHTOOL=y
BR2_PACKAGE_ETHTOOL_PRETTY_PRINT=y
BR2_PACKAGE_RSYNC=y
BR2_PACKAGE_SCREEN=y
BR2_PACKAGE_UTIL_LINUX=y
BR2_PACKAGE_UTIL_LINUX_LIBBLKID=y
BR2_PACKAGE_UTIL_LINUX_LIBMOUNT=y
BR2_PACKAGE_UTIL_LINUX_LIBUUID=y
BR2_PACKAGE_NANO=y
BR2_PACKAGE_NANO_TINY=y
BR2_PACKAGE_UEMACS=y
```

## configs/hrv_ediggenesys2_defconfig
```kconfig
# Architecture
BR2_riscv=y
BR2_riscv_custom=y
BR2_RISCV_ISA_CUSTOM_RVM=y
BR2_RISCV_ISA_CUSTOM_RVC=y

# Toolchain
BR2_TOOLCHAIN_EXTERNAL=y
BR2_TOOLCHAIN_EXTERNAL_CUSTOM=y
BR2_TOOLCHAIN_EXTERNAL_PREINSTALLED=y
BR2_TOOLCHAIN_EXTERNAL_PATH="$(HERO_INSTALL)"
BR2_TOOLCHAIN_EXTERNAL_CUSTOM_PREFIX="riscv64-unknown-linux-gnu"
BR2_TOOLCHAIN_EXTERNAL_GCC_8=y
BR2_TOOLCHAIN_EXTERNAL_HEADERS_4_20=y
BR2_TOOLCHAIN_EXTERNAL_CUSTOM_GLIBC=y
BR2_TOOLCHAIN_EXTERNAL_CXX=y

# System
BR2_TARGET_GENERIC_HOSTNAME="ariane"
BR2_TARGET_GENERIC_ISSUE="Welcome to Ariane"
BR2_SYSTEM_DHCP="eth0"
BR2_TARGET_ROOTFS_INITRAMFS=y
BR2_ROOTFS_OVERLAY="$(BR2_EXTERNAL_HERO_PATH)/board/common/overlay/"
BR2_ROOTFS_POST_BUILD_SCRIPT="$(BR2_EXTERNAL_HERO_PATH)/board/common/post_build.sh $(BR2_EXTERNAL_HERO_PATH)/board/rv/post_build.sh"
BR2_ROOTFS_POST_IMAGE_SCRIPT="$(BR2_EXTERNAL_HERO_PATH)/board/diggenesys2/post_image.sh"

# Bootloader
# FIXME: this should be a boot loader target
BR2_PACKAGE_RISCV_PK_ARIANE=y
BR2_PACKAGE_RISCV_PK_ARIANE_LOGO="$(BR2_EXTERNAL_HERO_PATH)/board/common/boot_logo.txt"

# Kernel
BR2_LINUX_KERNEL=y
BR2_LINUX_KERNEL_CUSTOM_VERSION=y
BR2_LINUX_KERNEL_CUSTOM_VERSION_VALUE="4.20.8"
BR2_LINUX_KERNEL_PATCH="$(BR2_EXTERNAL_HERO_PATH)/board/diggenesys2/linux-patches/"
BR2_LINUX_KERNEL_USE_CUSTOM_CONFIG=y
BR2_LINUX_KERNEL_CUSTOM_CONFIG_FILE="$(BR2_EXTERNAL_HERO_PATH)/board/rv/linux.config"
BR2_LINUX_KERNEL_CONFIG_FRAGMENT_FILES="$(BR2_EXTERNAL_HERO_PATH)/board/diggenesys2/linux-extras.config"
BR2_LINUX_KERNEL_VMLINUX=y

# BusyBox
BR2_PACKAGE_BUSYBOX_CONFIG="$(BR2_EXTERNAL_HERO_PATH)/board/common/busybox.config"

# Local packages
BR2_PACKAGE_OVERRIDE_FILE="$(BR2_EXTERNAL_HERO_PATH)/local.mk"
BR2_PACKAGE_ARIANE_SUPPORT=y
BR2_PACKAGE_ARIANE_SUPPORT_RANDOM_INIT=y
BR2_PACKAGE_VITETRIS=y

# Generic packages
BR2_PACKAGE_NFS_UTILS=y
BR2_PACKAGE_LIBNFS=y
BR2_PACKAGE_IPROUTE2=y
BR2_PACKAGE_DROPBEAR=y
BR2_PACKAGE_RSYNC=y
BR2_PACKAGE_IFUPDOWN_SCRIPTS=y
```

## configs/hrv_occamy_defconfig
```kconfig
# Host
BR2_CCACHE=y
BR2_CCACHE_USE_BASEDIR=n

# Architecture
BR2_riscv=y
BR2_riscv_custom=y
BR2_RISCV_ISA_CUSTOM_RVM=y
BR2_RISCV_ISA_CUSTOM_RVF=y
BR2_RISCV_ISA_CUSTOM_RVD=y
BR2_RISCV_ISA_CUSTOM_RVC=y

# BR2 internals
BR2_HOST_DIR="$(BR2_EXTERNAL)/install"
BR2_CCACHE=y
BR2_CCACHE_DIR="$(BR2_EXTERNAL)/.buildroot-ccache"

# Toolchain
BR2_TOOLCHAIN_EXTERNAL=y
BR2_TOOLCHAIN_EXTERNAL_CUSTOM=y
BR2_TOOLCHAIN_EXTERNAL_PREINSTALLED=y
BR2_TOOLCHAIN_EXTERNAL_PATH="$(HERO_INSTALL)"
BR2_TOOLCHAIN_EXTERNAL_CUSTOM_PREFIX="riscv64-unknown-linux-gnu"
BR2_TOOLCHAIN_EXTERNAL_GCC_8=y
BR2_TOOLCHAIN_EXTERNAL_HEADERS_4_20=y
BR2_TOOLCHAIN_EXTERNAL_CUSTOM_GLIBC=y
BR2_TOOLCHAIN_EXTERNAL_CXX=y

# System
BR2_TARGET_GENERIC_HOSTNAME="hero-occamy"
BR2_TARGET_GENERIC_ISSUE="Welcome to HERO Occamy"
BR2_TARGET_GENERIC_PASSWD_SHA512=y
BR2_TARGET_GENERIC_PASSWD_METHOD="sha-512"
BR2_ROOTFS_SKELETON_DEFAULT=y
BR2_ROOTFS_OVERLAY="$(BR2_EXTERNAL_HERO_PATH)/board/common/overlay/"
BR2_ROOTFS_POST_BUILD_SCRIPT="$(BR2_EXTERNAL_HERO_PATH)/board/common/post_build.sh $(BR2_EXTERNAL_HERO_PATH)/board/rv/post_build.sh $(BR2_EXTERNAL_HERO_PATH)/board/hero/post_build.sh"
BR2_ROOTFS_POST_IMAGE_SCRIPT="$(BR2_EXTERNAL_HERO_PATH)/board/occamy/post_image.sh"

# Kernel
BR2_LINUX_KERNEL=y
BR2_LINUX_KERNEL_CUSTOM_VERSION=y
BR2_LINUX_KERNEL_CUSTOM_VERSION_VALUE="5.16.9"
BR2_LINUX_KERNEL_PATCH="$(BR2_EXTERNAL)/board/occamy/patches/linux-5.16.9"
BR2_LINUX_KERNEL_USE_CUSTOM_CONFIG=y
BR2_LINUX_KERNEL_CUSTOM_CONFIG_FILE="$(BR2_EXTERNAL_HERO_PATH)/board/occamy/linux.config"

# Skeleton and BusyBox
BR2_PACKAGE_BUSYBOX=y
BR2_PACKAGE_BUSYBOX_CONFIG_FRAGMENT_FILES="$(BR2_EXTERNAL_HERO_PATH)/board/occamy/busybox_fragment.config"

# Local packages
BR2_PACKAGE_HERO_PLATFORM="ARIANE"
BR2_PACKAGE_HERO_OPENMP=y
BR2_PACKAGE_HERO_OPENMP_DEVICE_SNITCH=y
BR2_PACKAGE_LIBPULP=n
BR2_PACKAGE_LIBSNITCH=y
BR2_PACKAGE_LIBSNITCH_DEBUG_LEVEL=10
BR2_PACKAGE_SNITCH_DRIVER=y
BR2_PACKAGE_SNITCH_DRIVER_DEBUG_LEVEL=10
BR2_PACKAGE_HERO_SNITCH_APPS=y

# Generic packages
BR2_PACKAGE_DROPBEAR=y
BR2_PACKAGE_ETHTOOL=y
BR2_PACKAGE_RSYNC=y

# Image
BR2_TARGET_ROOTFS_CPIO_GZIP=y
BR2_TARGET_ROOTFS_EXT2=y
BR2_TARGET_ROOTFS_INITRAMFS=y

# Boot
BR2_TARGET_OPENSBI=y
BR2_TARGET_OPENSBI_CUSTOM_VERSION=y
BR2_TARGET_OPENSBI_CUSTOM_VERSION_VALUE="1.0"
BR2_TARGET_OPENSBI_PLAT="generic"
# BR2_TARGET_OPENSBI_INSTALL_JUMP_IMG is not set

BR2_TARGET_UBOOT=y
BR2_TARGET_UBOOT_BUILD_SYSTEM_KCONFIG=y
BR2_TARGET_UBOOT_CUSTOM_VERSION=y
BR2_TARGET_UBOOT_CUSTOM_VERSION_VALUE="2021.07"
BR2_TARGET_UBOOT_PATCH="$(BR2_EXTERNAL)/board/occamy/patches/u-boot-v2021.07"
BR2_TARGET_UBOOT_BOARD_DEFCONFIG="pulp-platform_occamy"
BR2_TARGET_UBOOT_NEEDS_OPENSBI=y
BR2_TARGET_UBOOT_FORMAT_ELF=y
BR2_TARGET_UBOOT_FORMAT_CUSTOM=y
BR2_TARGET_UBOOT_FORMAT_CUSTOM_NAME="u-boot.itb"
BR2_TARGET_UBOOT_SPL=y
```
