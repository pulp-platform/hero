## configs/qemu_defconfig
```kconfig
# Architecture
BR2_riscv=y
BR2_riscv_custom=y
BR2_RISCV_ISA_CUSTOM_RVM=y
BR2_RISCV_ISA_CUSTOM_RVC=y

# Toolchain
BR2_TOOLCHAIN_EXTERNAL=y
BR2_TOOLCHAIN_EXTERNAL_PATH="$(RISCV)"
BR2_TOOLCHAIN_EXTERNAL_CUSTOM_PREFIX="riscv64-unknown-linux-gnu"
BR2_TOOLCHAIN_EXTERNAL_GCC_8=y
BR2_TOOLCHAIN_EXTERNAL_HEADERS_4_20=y
BR2_TOOLCHAIN_EXTERNAL_CUSTOM_GLIBC=y
BR2_TOOLCHAIN_EXTERNAL_CXX=y

# Patches
BR2_GLOBAL_PATCH_DIR="$(BR2_EXTERNAL_HERO_PATH)/board/qemu/patches"

# System
BR2_TARGET_GENERIC_HOSTNAME="qemu"
BR2_SYSTEM_DHCP="eth0"

# Bootloader
BR2_TARGET_RISCV_PK=y

# Filesystem
BR2_TARGET_GENERIC_GETTY=y
BR2_TARGET_GENERIC_GETTY_PORT="ttyS0"
BR2_TARGET_ROOTFS_EXT2=y
BR2_ROOTFS_OVERLAY="$(BR2_EXTERNAL_HERO_PATH)/board/common/overlay/ $(BR2_EXTERNAL_HERO_PATH)/board/qemu/overlay/"
BR2_ROOTFS_POST_BUILD_SCRIPT="$(BR2_EXTERNAL_HERO_PATH)/board/common/post_build.sh"
BR2_ROOTFS_POST_IMAGE_SCRIPT="$(BR2_EXTERNAL_HERO_PATH)/board/qemu/post_image.sh"

# Kernel
BR2_LINUX_KERNEL=y
BR2_LINUX_KERNEL_CUSTOM_VERSION=y
BR2_LINUX_KERNEL_CUSTOM_VERSION_VALUE="4.20.8"
BR2_LINUX_KERNEL_USE_CUSTOM_CONFIG=y
BR2_LINUX_KERNEL_CUSTOM_CONFIG_FILE="$(BR2_EXTERNAL_HERO_PATH)/board/common/linux.config"
BR2_LINUX_KERNEL_CONFIG_FRAGMENT_FILES="$(BR2_EXTERNAL_HERO_PATH)/board/qemu/linux-extras.config"
BR2_LINUX_KERNEL_VMLINUX=y

# BusyBox
BR2_PACKAGE_BUSYBOX_CONFIG="$(BR2_EXTERNAL_HERO_PATH)/board/common/busybox.config"

# Local packages
BR2_PACKAGE_VITETRIS=y

#  Generic packages
BR2_PACKAGE_DROPBEAR=y
BR2_PACKAGE_IFUPDOWN_SCRIPTS=y
```

## configs/zynqmp_zcu102_defconfig
```kconfig
# System
BR2_GLOBAL_PATCH_DIR="board/zynqmp/patches/"
BR2_PACKAGE_HOST_LINUX_HEADERS_CUSTOM_4_14=y

# Architecture
BR2_aarch64=y

# Toolchain
BR2_TOOLCHAIN_EXTERNAL=y
BR2_TOOLCHAIN_EXTERNAL_CUSTOM=y
BR2_TOOLCHAIN_EXTERNAL_PREINSTALLED=y
BR2_TOOLCHAIN_EXTERNAL_PATH="$(RISCV)"
BR2_TOOLCHAIN_EXTERNAL_CUSTOM_PREFIX="aarch64-unknown-linux-gnu"
BR2_TOOLCHAIN_EXTERNAL_GCC_8=y
BR2_TOOLCHAIN_EXTERNAL_HEADERS_4_14=y
BR2_TOOLCHAIN_EXTERNAL_CUSTOM_GLIBC=y
BR2_TOOLCHAIN_EXTERNAL_CXX=y

# System
BR2_TARGET_GENERIC_HOSTNAME="zynqmp"
BR2_TARGET_GENERIC_ISSUE="Welcome to ZynqMP"
BR2_TARGET_ROOTFS_EXT2=y
BR2_TARGET_ROOTFS_EXT2_4=y
BR2_ROOTFS_OVERLAY="$(BR2_EXTERNAL_HERO_PATH)/board/common/overlay/"
BR2_ROOTFS_POST_BUILD_SCRIPT="$(BR2_EXTERNAL_HERO_PATH)/board/common/post_build.sh $(BR2_EXTERNAL_HERO_PATH)/board/zynqmp/post_build.sh"
BR2_ROOTFS_POST_IMAGE_SCRIPT="board/zynqmp/post-image.sh"

# Bootloader
BR2_TARGET_ARM_TRUSTED_FIRMWARE=y
BR2_TARGET_ARM_TRUSTED_FIRMWARE_CUSTOM_GIT=y
BR2_TARGET_ARM_TRUSTED_FIRMWARE_CUSTOM_REPO_URL="https://github.com/Xilinx/arm-trusted-firmware.git"
BR2_TARGET_ARM_TRUSTED_FIRMWARE_CUSTOM_REPO_VERSION="xilinx-v2018.2"
BR2_TARGET_ARM_TRUSTED_FIRMWARE_PLATFORM="zynqmp"
BR2_TARGET_ARM_TRUSTED_FIRMWARE_BL31_UBOOT=y
BR2_TARGET_UBOOT=y
BR2_TARGET_UBOOT_BUILD_SYSTEM_KCONFIG=y
BR2_TARGET_UBOOT_CUSTOM_GIT=y
BR2_TARGET_UBOOT_CUSTOM_REPO_URL="git://github.com/xilinx/u-boot-xlnx.git"
BR2_TARGET_UBOOT_CUSTOM_REPO_VERSION="228801a215909365ae1dcdd799034195ad7264f7"
BR2_TARGET_UBOOT_BOARD_DEFCONFIG="xilinx_zynqmp_zcu102_rev1_0"
BR2_TARGET_UBOOT_NEEDS_DTC=y
BR2_TARGET_UBOOT_SPL=y
BR2_TARGET_UBOOT_SPL_NAME="spl/boot.bin"
BR2_TARGET_UBOOT_ZYNQMP=y
BR2_TARGET_UBOOT_ZYNQMP_PMUFW="$(BR2_EXTERNAL_HERO_PATH)/board/zynqmp/zcu102_pmufw.bin"

# Kernel
BR2_LINUX_KERNEL=y
BR2_LINUX_KERNEL_CUSTOM_GIT=y
BR2_LINUX_KERNEL_CUSTOM_REPO_URL="git://github.com/Xilinx/linux-xlnx.git"
BR2_LINUX_KERNEL_CUSTOM_REPO_VERSION="xilinx-v2018.2"
BR2_LINUX_KERNEL_DEFCONFIG="xilinx_zynqmp"
BR2_LINUX_KERNEL_DTS_SUPPORT=y
BR2_LINUX_KERNEL_INTREE_DTS_NAME="xilinx/zynqmp-zcu102-rev1.0"

# Host packages
BR2_PACKAGE_HOST_DOSFSTOOLS=y
BR2_PACKAGE_HOST_GENIMAGE=y
BR2_PACKAGE_HOST_MTOOLS=y
BR2_PACKAGE_HOST_ZYNQ_MKBOOTIMAGE=y

# Local packages
BR2_PACKAGE_VITETRIS=y

# Generic packages
BR2_PACKAGE_NFS_UTILS=y
BR2_PACKAGE_LIBNFS=y
BR2_PACKAGE_IPROUTE2=y
BR2_PACKAGE_DROPBEAR=y
BR2_PACKAGE_RSYNC=y
BR2_PACKAGE_IFUPDOWN_SCRIPTS=y
```

## package/ariane-support/Config.in
```kconfig
config BR2_PACKAGE_ARIANE_SUPPORT
	bool "Generic support scripts and binaries for Ariane"

if BR2_PACKAGE_ARIANE_SUPPORT

config BR2_PACKAGE_ARIANE_SUPPORT_RANDOM_INIT
	bool "Force random initialization from pre-generated data"
	default y
	help
	  Determines if random initialization from pre-generated data
	  should be used.  As support for hardware random number
	  generation is currently lacking, this should prevent the boot
	  from hanging waiting for random entropy. The randomized data
	  is pre-generated on the build system and will be the same
	  every boot, making this very INSECURE for production.

config BR2_PACKAGE_ARIANE_SUPPORT_ETH_MAC
	string "Alternative MAC address for ethernet"
	help
	  Hack to update standard MAC address from device tree to custom
	  version.  Leave empty to use default MAC address
	  00:18:3e:02:e3:7f.

endif
```

## package/hero-apps/Config.in
```kconfig
config BR2_PACKAGE_HERO_APPS
	bool "Support applications (standalone/UART) for HERO"
	select BR2_PACKAGE_LIBPULP
```

## package/hero-openmp/Config.in
```kconfig
config BR2_PACKAGE_HERO_OPENMP
	bool "LLVM OpenMP offload plugin for HERO accelerators (Snitch/PULP)"
	select BR2_PACKAGE_ELFUTILS
	select BR2_PACKAGE_LIBFFI
	depends on BR2_PACKAGE_HERO_PLATFORM != ""

choice
	prompt "HERO Device type"
	depends on BR2_PACKAGE_HERO_OPENMP
	help
	  Select what device to target for offloading

config BR2_PACKAGE_HERO_OPENMP_DEVICE_PULP
	bool "PULP device"
	select BR2_PACKAGE_LIBPULP

config BR2_PACKAGE_HERO_OPENMP_DEVICE_SNITCH
	bool "Snitch device"
	select BR2_PACKAGE_LIBSNITCH

endchoice

config BR2_PACKAGE_HERO_OPENMP_ENABLE_PREM
	bool "Enable support for PREM in HERO OpenMP"
	select BR2_PACKAGE_PREM_CMUX
	depends on BR2_PACKAGE_HERO_PLATFORM != ""

comment "LLVM OpenMP PULP plugin needs a well-defined HERO platform"
	depends on BR2_PACKAGE_HERO_PLATFORM = ""
```

## package/hero-snitch-apps/Config.in
```kconfig
config BR2_PACKAGE_HERO_SNITCH_APPS
	bool "Support applications (standalone/UART) for HERO with Snitch device"
	select BR2_PACKAGE_LIBSNITCH
```

## package/hero-support/Config.in
```kconfig
comment "hero-support needs a Linux kernel to be built"
	depends on !BR2_LINUX_KERNEL

config BR2_PACKAGE_HERO_SUPPORT
	bool "hero-support"
	depends on BR2_LINUX_KERNEL
	help
		HERO support infrastructure with PULP linux kernel driver,
		user-space libraries and support binaries.


if BR2_PACKAGE_HERO_SUPPORT

config BR2_PACKAGE_HERO_SUPPORT_DEBUG_LEVEL
  int "Debug level"
  default 0
  help
    Debug level for HERO support drivers and libraries. Higher is more verbose.
    If more than zero the binaries are also compiled with debugging symbols.

endif
```

## package/libhero-target/Config.in
```kconfig
config BR2_PACKAGE_LIBHERO_TARGET
	bool "HERO target API and library for Host and accelerator"
```

## package/libpulp/Config.in
```kconfig
config BR2_PACKAGE_LIBPULP
	bool "libpulp: PULP userspace library"
	depends on BR2_LINUX_KERNEL
	depends on BR2_PACKAGE_HERO_PLATFORM != ""

comment "libpulp needs a Linux kernel to be built"
	depends on !BR2_LINUX_KERNEL

comment "libpulp needs a well-defined HERO platform"
	depends on BR2_PACKAGE_HERO_PLATFORM = ""

if BR2_PACKAGE_LIBPULP

config BR2_PACKAGE_LIBPULP_DEBUG_LEVEL
	int "libpulp debug level"
	default 0
	help
	  Debug level for libpulp support library.  Higher is more
	  verbose.  If more than zero, the binaries are also compiled
	  with debugging symbols.

endif
```

## package/libsnitch/Config.in
```kconfig
config BR2_PACKAGE_LIBSNITCH
	bool "libsnitch: Snitch userspace library"
	depends on BR2_LINUX_KERNEL
	depends on BR2_PACKAGE_HERO_PLATFORM != ""

comment "libsnitch needs a Linux kernel to be built"
	depends on !BR2_LINUX_KERNEL

comment "libsnitch needs a well-defined HERO platform"
	depends on BR2_PACKAGE_HERO_PLATFORM = ""

if BR2_PACKAGE_LIBSNITCH

config BR2_PACKAGE_LIBSNITCH_DEBUG_LEVEL
	int "libsnitch debug level"
	default 0
	help
	  Debug level for libsnitch support library.  Higher is more
	  verbose.  If more than zero, the binaries are also compiled
	  with debugging symbols.

endif
```

## package/prem-cmux/Config.in
```kconfig
config BR2_PACKAGE_PREM_CMUX
	bool "CMUX PREM Arbitrator and interfacing library"
	depends on BR2_PACKAGE_HERO_PLATFORM != ""
```

## package/pulp-driver/Config.in
```kconfig
config BR2_PACKAGE_PULP_DRIVER
	bool "Linux kernel driver for PULP"
	depends on BR2_LINUX_KERNEL
	depends on BR2_PACKAGE_HERO_PLATFORM
	depends on BR2_PACKAGE_LIBPULP

comment "PULP driver needs a Linux kernel to be built"
	depends on !BR2_LINUX_KERNEL

comment "PULP driver needs a well-defined HERO platform"
	depends on !BR2_PACKAGE_HERO_PLATFORM

if BR2_PACKAGE_PULP_DRIVER

comment "PULP driver requires headers from libpulp"
	depends on !BR2_PACKAGE_LIBPULP

config BR2_PACKAGE_PULP_DRIVER_DEBUG_LEVEL
	int "PULP driver debug level"
	default 0
	help
	  Debug level for PULP driver.  Higher is more verbose.  If more
	  than zero, the binaries are also compiled with debugging
	  symbols.

endif
```

## package/riscv-pk-ariane/Config.in
```kconfig
config BR2_PACKAGE_RISCV_PK_ARIANE
	bool "RISC-V Proxy Kernel (pk) for Ariane"
	depends on BR2_riscv
	depends on BR2_LINUX_KERNEL
	help
	  The RISC-V Proxy Kernel (pk) package contains the Berkeley
	  Boot Loader (BBL) which has been designed to boot a Linux
	  kernel on a RISC-V processor.  Modified to boot Ariane.

	  https://github.com/pulp-platform/riscv-pk

comment "RISC-V pk for Ariane needs a RISC-V Linux kernel to be built"
	depends on !BR2_riscv
	depends on !BR2_LINUX_KERNEL

if BR2_PACKAGE_RISCV_PK_ARIANE

config BR2_PACKAGE_RISCV_PK_ARIANE_LOGO
	string "extra configure opts"
	help
	  Path to optional logo to display during load.

endif
```

## package/snitch-driver/Config.in
```kconfig
config BR2_PACKAGE_SNITCH_DRIVER
	bool "Linux kernel driver for Snitch"
	depends on BR2_LINUX_KERNEL
	depends on BR2_PACKAGE_HERO_PLATFORM != ""

comment "Snitch driver needs a Linux kernel to be built"
	depends on !BR2_LINUX_KERNEL

comment "Snitch driver needs a well-defined HERO platform"
	depends on BR2_PACKAGE_HERO_PLATFORM = ""

if BR2_PACKAGE_SNITCH_DRIVER

config BR2_PACKAGE_SNITCH_DRIVER_DEBUG_LEVEL
	int "Snitch driver debug level"
	default 0
	help
	  Debug level for SNITCH driver.  Higher is more verbose.  If more
	  than zero, the binaries are also compiled with debugging
	  symbols.

endif
```

## package/vitetris/Config.in
```kconfig
config BR2_PACKAGE_VITETRIS
	bool "vitetris"
	help
	  Classic multiplayer tetris for the terminal
```

## package/zynq-fclkcfg/Config.in
```kconfig
config BR2_PACKAGE_ZYNQ_FCLKCFG
	depends on BR2_arm || BR2_aarch64
	depends on BR2_LINUX_KERNEL
       bool "Kernel driver to dynamically configure ZynqMP FPGA clocks"
       help
         https://github.com/ikwzm/fclkcfg

comment "zynq-fclkcfg needs a ARM Linux kernel to be built"
	depends on !BR2_arm && !BR2_aarch64
	depends on !BR2_LINUX_KERNEL
```

## package/zynq-mkbootimage/Config.in.host
```kconfig
config BR2_PACKAGE_HOST_ZYNQ_MKBOOTIMAGE
	bool "Tool to build Zynq boot image files"
	help
	  https://github.com/antmicro/zynq-mkbootimage
```
